## config/west.yml
```yaml
manifest:
  remotes:
    - name: zmkfirmware
      url-base: https://github.com/zmkfirmware
    - name: Merlinov
      url-base: https://github.com/Merlinov
  
  projects:
    - name: zmk
      remote: Merlinov
      revision: main
      import: app/west.yml
  self:
    path: config
```
